## CMakeLists.txt
```
cmake_minimum_required(VERSION 3.20.0)
find_package(Zephyr REQUIRED HINTS $ENV{ZEPHYR_BASE})

project(blink)

include_directories(inc)
target_sources(app PRIVATE src/main.c)
```

## west.yml
```
manifest:
    version: 1.2

    projects:
        # Nordic's nRF Connect SDK
        - name: nrf
          url: https://github.com/nrfconnect/sdk-nrf
          revision: v2.7.0
          import:
              file: west.yml
              path-prefix: deps
              name-allowlist:
                  - cmsis
                  - hal_nordic
                  - nrfxlib
                  - zephyr
        # Capbot's zephyr board definitions
        - name: capbot-zephyr-boards
          url: https://gitlab.kuleuven.be/distrinet/taskforces/nes/freebot/zephyr-boards
          revision: v2.0
          path: deps/modules/capbot/boards
        # Capbot's zephyr library
        - name: capbot-zephyr-library
          url: https://gitlab.kuleuven.be/distrinet/taskforces/nes/freebot/zephyr-library
          revision: zephyr-module # TODO: checkout specific version once stable
          path: deps/modules/capbot/lib

    self:
        path: app
```

## prj.conf
```kconfig
# Blink does not require any special setting
```

## src/main.c
```c
/**
 * @file main.c
 * @author Lowie Deferme <lowie.deferme@kuleuven.be>
 * @brief CapBot drive example
 */

#include "capbot.h"
#include <zephyr/kernel.h>

#define DELAY K_MSEC(1000)

int main(void)
{
    if (cb_motor_init())
    {
        return -1;
    }

    for (;;)
    {
        cb_drive_forw(20);
        k_sleep(DELAY);
        cb_drive_back(20);
        k_sleep(DELAY);
        cb_drive_right(60);
        k_sleep(DELAY);
        cb_drive_left(60);
        k_sleep(DELAY);
        cb_rotate_cw(80);
        k_sleep(DELAY);
        cb_rotate_ccw(80);
        k_sleep(DELAY);
        cb_stop();
        k_sleep(DELAY);
    }

    // Unreachable
    return 0;
}
```
