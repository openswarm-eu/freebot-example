## CMakeLists.txt
```
cmake_minimum_required(VERSION 3.20.0)
find_package(Zephyr REQUIRED HINTS $ENV{ZEPHYR_BASE})

project(hello-world)

include_directories(inc)
target_sources(app PRIVATE src/main.c)
```

## west.yml
```
manifest:
    version: 1.2

    projects:
        # Nordic's nRF Connect SDK
        - name: nrf
          url: https://github.com/nrfconnect/sdk-nrf
          revision: v2.7.0
          import:
              file: west.yml
              path-prefix: deps
              name-allowlist:
                  - cmsis
                  - hal_nordic
                  - nrfxlib
                  - zephyr
        # Capbot's zephyr library
        - name: capbot-zephyr-library
          url: https://gitlab.kuleuven.be/distrinet/taskforces/nes/freebot/zephyr-library
          revision: zephyr-module # TODO: checkout specific version once stable
          path: deps/modules/capbot/lib
        # Capbot's zephyr board definitions
        - name: capbot-zephyr-boards
          url: https://gitlab.kuleuven.be/distrinet/taskforces/nes/freebot/zephyr-boards
          revision: zephyr-module # TODO: checkout specific version once stable
          path: deps/modules/capbot/boards

    self:
        path: app
```

## prj.conf
```kconfig
# Enable serial driver
CONFIG_SERIAL=y

# Enable console drivers
CONFIG_CONSOLE=y
CONFIG_UART_CONSOLE=y

# Enable logging
CONFIG_LOG=y
```

## src/main.c
```c
/**
 * @file main.c
 * @author Lowie Deferme <lowie.deferme@kuleuven.be>
 * @brief Capbot zephyr API example
 */

#include <zephyr/kernel.h>
#include <zephyr/logging/log.h>

LOG_MODULE_REGISTER(capbot, LOG_LEVEL_DBG);

void main(void)
{
    for (;;)
    {
        LOG_INF("Hello world");
        k_sleep(K_MSEC(1000));
    }
}
```
